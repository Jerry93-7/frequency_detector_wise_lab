## esp32/adc_embed/build/Kconfig/boards/Kconfig.sysbuild
```kconfig
# Load Sysbuild board Kconfig descriptions.
osource "/home/jerryfen/zephyrproject/zephyr/boards/espressif/esp32c6_devkitc/Kconfig.sysbuild"
```

## esp32/adc_pulley_embed/build/Kconfig/arch/Kconfig
```kconfig
# Load Zephyr Arch Kconfig descriptions.
osource "/home/jerryfen/zephyrproject/zephyr/arch/rx/Kconfig"
osource "/home/jerryfen/zephyrproject/zephyr/arch/x86/Kconfig"
osource "/home/jerryfen/zephyrproject/zephyr/arch/xtensa/Kconfig"
osource "/home/jerryfen/zephyrproject/zephyr/arch/sparc/Kconfig"
osource "/home/jerryfen/zephyrproject/zephyr/arch/riscv/Kconfig"
osource "/home/jerryfen/zephyrproject/zephyr/arch/posix/Kconfig"
osource "/home/jerryfen/zephyrproject/zephyr/arch/mips/Kconfig"
osource "/home/jerryfen/zephyrproject/zephyr/arch/arm64/Kconfig"
osource "/home/jerryfen/zephyrproject/zephyr/arch/arm/Kconfig"
osource "/home/jerryfen/zephyrproject/zephyr/arch/arc/Kconfig"
```

## esp32/adc_pulley_embed/build/Kconfig/boards/Kconfig
```kconfig
# Load Zephyr board Kconfig descriptions.
osource "/home/jerryfen/zephyrproject/zephyr/boards/espressif/esp32c6_devkitc/Kconfig"
```

## esp32/adc_pulley_embed/build/Kconfig/boards/Kconfig.defconfig
```kconfig
# Load Zephyr board defconfig descriptions.
osource "/home/jerryfen/zephyrproject/zephyr/boards/espressif/esp32c6_devkitc/Kconfig.defconfig"
```

## esp32/adc_pulley_embed/wasmtime-rr-prototyping/pulley_exp_wasmtime_nostd/build/Kconfig/boards/Kconfig
```kconfig
# Load Zephyr board Kconfig descriptions.
osource "/home/jerryfen/zephyrproject/zephyr/boards/qemu/riscv32/Kconfig"
```

## esp32/adc_pulley_embed/wasmtime-rr-prototyping/pulley_exp_wasmtime_nostd/build/Kconfig/boards/Kconfig.defconfig
```kconfig
# Load Zephyr board defconfig descriptions.
osource "/home/jerryfen/zephyrproject/zephyr/boards/qemu/riscv32/Kconfig.defconfig"
```

## esp32/adc_pulley_embed/wasmtime-rr-prototyping/pulley_exp_wasmtime_nostd/build/Kconfig/boards/Kconfig.qemu_riscv32.tmp
```kconfig
# Load board Kconfig descriptions.
osource "/home/jerryfen/zephyrproject/zephyr/boards/qemu/riscv32/Kconfig.qemu_riscv32"
```

## esp32/adc_pulley_embed/wasmtime-rr-prototyping/pulley_exp_wasmtime_nostd/build/Kconfig/boards/Kconfig.sysbuild
```kconfig
# Load Sysbuild board Kconfig descriptions.
osource "/home/jerryfen/zephyrproject/zephyr/boards/qemu/riscv32/Kconfig.sysbuild"
```
